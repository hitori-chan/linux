## Documentation/devicetree/bindings/input/apple,t8112-dockchannel-hid.yaml
```yaml
# SPDX-License-Identifier: (GPL-2.0-only OR BSD-2-Clause)
%YAML 1.2
---
$id: http://devicetree.org/schemas/input/apple,t8112-dockchannel-hid.yaml#
$schema: http://devicetree.org/meta-schemas/core.yaml#

title: Apple DockChannel HID Transport

maintainers:
  - Michael Reeves <michael.reeves077@gmail.com>

description:
  HID transport for keyboard and trackpad devices connected via the
  DockChannel FIFO mailbox on Apple Silicon SoCs. The endpoint includes a
  small RTKit coprocessor called MTP which must be booted before the HID
  transport becomes available.

properties:
  compatible:
    oneOf:
      - items:
          - const: apple,t8112-dockchannel-hid
      - items:
          - enum:
              - apple,t6020-dockchannel-hid
              - apple,t6030-dockchannel-hid
              - apple,t6031-dockchannel-hid
              - apple,t8122-dockchannel-hid
          - const: apple,t8112-dockchannel-hid

  reg:
    items:
      - description: Coprocessor ASC registers
      - description: Coprocessor SRAM/mailbox registers

  reg-names:
    items:
      - const: asc
      - const: sram

  mboxes:
    items:
      - description: ASC mailbox used for RTKit control
      - description: DockChannel FIFO mailbox used for HID packets

  mbox-names:
    items:
      - const: asc
      - const: dockchannel

  iommus:
    maxItems: 1

  apple,has-stm:
    type: boolean
    description:
      Specifies that the coprocessor provides STM device and serial
      number query endpoints that must be ready before registering HID devices.

  hid-country-code:
    $ref: /schemas/types.yaml#/definitions/uint32
    description:
      HID country code for the keyboard layout variant.

required:
  - compatible
  - reg
  - reg-names
  - mboxes
  - mbox-names
  - iommus

additionalProperties: false

examples:
  - |
    soc {
        #address-cells = <2>;
        #size-cells = <2>;

        hid@24e400000 {
            compatible = "apple,t8112-dockchannel-hid";
            reg = <0x2 0x4e400000 0x0 0x4000>,
                  <0x2 0x4ec00000 0x0 0x100000>;
            reg-names = "asc", "sram";
            mboxes = <&mtp_mbox>, <&mtp_dockchannel>;
            mbox-names = "asc", "dockchannel";
            iommus = <&mtp_dart 1>;
            apple,has-stm;
            hid-country-code = <0>;
        };
    };
```

## Documentation/devicetree/bindings/media/apple,ave.yaml
```yaml
# SPDX-License-Identifier: GPL-2.0-only OR BSD-2-Clause
%YAML 1.2
---
$id: http://devicetree.org/schemas/media/apple,ave.yaml#
$schema: http://devicetree.org/meta-schemas/core.yaml#

title: Apple video encoder (AVE)

maintainers:
  - hitori-chan <hitori1403@gmail.com>

description:
  The H.264/HEVC video encoder of Apple silicon SoCs. A coprocessor in the
  block runs a firmware that iBoot preloads; the bootloader reserves its
  segments at their DART addresses and adds them, and a copy of the
  firmware's data segment, as memory regions. The host talks to the
  firmware through a mailbox of scratch registers and a doorbell. The
  coprocessor and the encoder sit behind their own DARTs.

properties:
  compatible:
    enum:
      - apple,t6031-ave

  reg:
    items:
      - description: encoder core
      - description: coprocessor
      - description: mailbox
      - description: AXI to fabric bridge

  reg-names:
    items:
      - const: core
      - const: iop
      - const: mbox
      - const: axi2af

  interrupts:
    maxItems: 5

  iommus:
    maxItems: 2

  power-domains:
    maxItems: 6

  power-domain-names:
    items:
      - const: sys
      - const: dma
      - const: pipe4
      - const: pipe5
      - const: me0
      - const: me1

  memory-region:
    description:
      The firmware's text and data segments (with their DART addresses in
      iommu-addresses) and a copy of the data segment, filled in by the
      bootloader.
    maxItems: 3

required:
  - compatible
  - reg
  - reg-names
  - interrupts
  - iommus
  - power-domains
  - power-domain-names

additionalProperties: false

examples:
  - |
    #include <dt-bindings/interrupt-controller/apple-aic.h>
    #include <dt-bindings/interrupt-controller/irq.h>

    soc {
        #address-cells = <2>;
        #size-cells = <2>;

        video-codec@285100000 {
            compatible = "apple,t6031-ave";
            reg = <0x2 0x85100000 0x0 0x45c000>,
                  <0x2 0x85800000 0x0 0x800000>,
                  <0x2 0x85050000 0x0 0x4000>,
                  <0x2 0x84000000 0x0 0x1000000>;
            reg-names = "core", "iop", "mbox", "axi2af";
            interrupt-parent = <&aic>;
            interrupts = <AIC_IRQ 0 1207 IRQ_TYPE_LEVEL_HIGH>,
                         <AIC_IRQ 0 1201 IRQ_TYPE_LEVEL_HIGH>,
                         <AIC_IRQ 0 1200 IRQ_TYPE_LEVEL_HIGH>,
                         <AIC_IRQ 0 1203 IRQ_TYPE_LEVEL_HIGH>,
                         <AIC_IRQ 0 1202 IRQ_TYPE_LEVEL_HIGH>;
            iommus = <&ave0_dart 0 0x100 0x0 0x1 0x0>,
                     <&ave0_iop_dart 0 0x100 0x0 0x1 0x0>;
            power-domains = <&ps_venc0_sys>, <&ps_venc0_dma>,
                            <&ps_venc0_pipe4>, <&ps_venc0_pipe5>,
                            <&ps_venc0_me0>, <&ps_venc0_me1>;
            power-domain-names = "sys", "dma", "pipe4", "pipe5", "me0", "me1";
        };
    };
```

## Documentation/devicetree/bindings/media/apple,jpeg.yaml
```yaml
# SPDX-License-Identifier: GPL-2.0-only
%YAML 1.2
---
$id: http://devicetree.org/schemas/media/apple,jpeg.yaml#
$schema: http://devicetree.org/meta-schemas/core.yaml#

title: Apple JPEG codec

maintainers:
  - hitori-chan <hitori1403@gmail.com>

description:
  The JPEG codec of Apple silicon SoCs. It runs no firmware; the host
  programs one job at a time through its registers and the codec reads the
  JPEG header from a register window. Each instance sits behind its own
  DART.

properties:
  compatible:
    items:
      - enum:
          - apple,t6031-jpeg
      - const: apple,jpeg

  reg:
    maxItems: 1

  interrupts:
    maxItems: 1

  iommus:
    maxItems: 1

  power-domains:
    maxItems: 1

required:
  - compatible
  - reg
  - interrupts
  - iommus
  - power-domains

additionalProperties: false

examples:
  - |
    #include <dt-bindings/interrupt-controller/apple-aic.h>
    #include <dt-bindings/interrupt-controller/irq.h>

    soc {
        #address-cells = <2>;
        #size-cells = <2>;

        jpeg@2cf000000 {
            compatible = "apple,t6031-jpeg", "apple,jpeg";
            reg = <0x2 0xcf000000 0x0 0x4000>;
            interrupt-parent = <&aic>;
            interrupts = <AIC_IRQ 0 1282 IRQ_TYPE_LEVEL_HIGH>;
            iommus = <&jpeg0_dart 0>;
            power-domains = <&ps_jpg>;
        };
    };
```

## Documentation/devicetree/bindings/memory-controllers/apple,mcc.yaml
```yaml
# SPDX-License-Identifier: GPL-2.0-only
%YAML 1.2
---
$id: http://devicetree.org/schemas/memory-controllers/apple,mcc.yaml#
$schema: http://devicetree.org/meta-schemas/core.yaml#

title: Apple memory cache controller

maintainers:
  - hitori-chan <hitori1403@gmail.com>

description:
  The memory cache controllers (AMCC) of Apple silicon SoCs. Each AMCC
  holds the system level cache's planes and the DRAM channel controllers
  (DCS) behind it. The bootloader enables the cache; the operating system
  enables the channel controllers' dynamic power gating.

properties:
  compatible:
    items:
      - enum:
          - apple,t6034-mcc
      - const: apple,t6031-mcc

  reg:
    description: One register range per AMCC.
    minItems: 1
    maxItems: 8

required:
  - compatible
  - reg

additionalProperties: false

examples:
  - |
    soc {
        #address-cells = <2>;
        #size-cells = <2>;

        memory-controller@220000000 {
            compatible = "apple,t6034-mcc", "apple,t6031-mcc";
            reg = <0x2 0x20000000 0x0 0x2000000>,
                  <0x2 0x22000000 0x0 0x2000000>;
        };
    };
```

## Documentation/devicetree/bindings/rtc/apple,smc-rtc.yaml
```yaml
# SPDX-License-Identifier: (GPL-2.0-only OR BSD-2-Clause)
%YAML 1.2
---
$id: http://devicetree.org/schemas/rtc/apple,smc-rtc.yaml#
$schema: http://devicetree.org/meta-schemas/core.yaml#

title: Apple SMC RTC

description:
  Apple Silicon Macs (M1, etc.) have an RTC that is part of the PMU IC,
  but most of the PMU functionality is abstracted out by the SMC.
  An additional RTC offset stored inside NVMEM is required to compute
  the current date/time.

maintainers:
  - Sven Peter <sven@kernel.org>

properties:
  compatible:
    const: apple,smc-rtc

  nvmem-cells:
    minItems: 1
    items:
      - description: 48bit RTC offset, specified in 32768 (2^15) Hz clock ticks
      - description: the PMU's alarm control register
      - description: the PMU's alarm register, the counter second to match
      - description: the PMU's alarm interrupt mask register
      - description:
          the PMU's alarm event register, where it is not the control
          register

  nvmem-cell-names:
    minItems: 1
    items:
      - const: rtc_offset
      - const: rtc_alarm_ctrl
      - const: rtc_alarm
      - const: rtc_irq_mask
      - const: rtc_alarm_event

  interrupts:
    description: the PMU's interrupt, which signals the alarm
    maxItems: 1

required:
  - compatible
  - nvmem-cells
  - nvmem-cell-names

additionalProperties: false
```

## drivers/accel/apple_ane/Kconfig
```kconfig
# SPDX-License-Identifier: GPL-2.0-only

config DRM_ACCEL_APPLE_ANE
	tristate "Apple silicon Neural Engine"
	depends on DRM_ACCEL
	depends on ARCH_APPLE || COMPILE_TEST
	depends on OF && IOMMU_DMA && PM
	select DRM_GEM_DMA_HELPER
	select DRM_SCHED
	select FW_LOADER
	help
	  The Neural Engine of Apple's M3 SoCs, which runs Apple's firmware:
	  the driver loads it from apple/ane-t603x.macho, extracted from macOS.

	  To compile this driver as a module, choose M here: the module will
	  be called apple-ane.
```

## drivers/media/platform/apple/ave/Kconfig
```kconfig
# SPDX-License-Identifier: GPL-2.0-only

config VIDEO_APPLE_AVE_PROBE
	tristate "Apple silicon video encoder firmware probe"
	depends on ARCH_APPLE || COMPILE_TEST
	depends on OF && IOMMU_DMA && PM
	select CRC32
	help
	  A test driver for the video encoder (AVE) of Apple silicon SoCs:
	  it powers the first encoder and runs the boot handshake with the
	  firmware iBoot preloads, logging the replies. It encodes nothing,
	  and binds only with its stop_after module option.

	  To compile this driver as a module, choose M here: the module
	  will be called apple-ave-probe.
```

## drivers/media/platform/apple/jpeg/Kconfig
```kconfig
# SPDX-License-Identifier: GPL-2.0-only

config VIDEO_APPLE_JPEG
	tristate "Apple silicon JPEG decoder"
	depends on V4L_MEM2MEM_DRIVERS
	depends on ARCH_APPLE || COMPILE_TEST
	depends on VIDEO_DEV
	select VIDEOBUF2_DMA_CONTIG
	select V4L2_MEM2MEM_DEV
	select V4L2_JPEG_HELPER
	help
	  This is a V4L2 memory-to-memory driver for the JPEG codec of
	  Apple silicon SoCs, which decodes baseline JPEG to YUV and RGB.

	  To compile this driver as a module, choose M here: the module
	  will be called apple-jpeg.
```

## drivers/media/platform/apple/prores/Kconfig
```kconfig
# SPDX-License-Identifier: GPL-2.0-only

config VIDEO_APPLE_PRORES
	tristate "Apple silicon ProRes codec"
	depends on V4L_MEM2MEM_DRIVERS
	depends on ARCH_APPLE || COMPILE_TEST
	depends on VIDEO_DEV
	select VIDEOBUF2_DMA_CONTIG
	select V4L2_MEM2MEM_DEV
	help
	  This is a V4L2 memory-to-memory driver for the ProRes codec of
	  Apple silicon SoCs.

	  To compile this driver as a module, choose M here: the module
	  will be called apple-prores.
```
