## drivers/media/platform/apple/ave/Kconfig
```kconfig
# SPDX-License-Identifier: GPL-2.0-only

config VIDEO_APPLE_AVE
	tristate "Apple silicon video encoder"
	depends on V4L_MEM2MEM_DRIVERS
	depends on ARCH_APPLE || COMPILE_TEST
	depends on VIDEO_DEV
	depends on OF && IOMMU_DMA && PM
	select VIDEOBUF2_DMA_CONTIG
	select VIDEOBUF2_VMALLOC
	select V4L2_MEM2MEM_DEV
	help
	  This is a V4L2 memory-to-memory H.264 and HEVC encoder driver for the video
	  encoder (AVE) of Apple silicon SoCs. It runs the firmware iBoot
	  preloads, whose segments the bootloader reserves: 9013.55.1, macOS
	  27.2's boot stub's, whose handshake, Start and Process are read from
	  macOS 27.2's AppleAVE2 and the firmware. Key and P frames of both
	  codecs, on both cores from 3840x2160 as macOS. On another firmware
	  the encoder registers no node.

	  To compile this driver as a module, choose M here: the module
	  will be called apple-ave.
```
